## arch/arm64/configs/whyred_hybrid_defconfig
```kconfig
# =============================================================================
# Whyred Hybrid Kernel 6.18 — reference defconfig fragment list
# =============================================================================
# Real builds start from GKI gki_defconfig then merge fragments via scripts/build.sh.
# This file documents the intended enabled options for the hybrid product.

# --- Architecture ---
CONFIG_ARM64=y
CONFIG_ARCH_QCOM=y
CONFIG_ARM64_4K_PAGES=y
CONFIG_SMP=y
CONFIG_NR_CPUS=8

# --- Android / GKI baseline (subset; full set comes from gki_defconfig) ---
CONFIG_ANDROID=y
CONFIG_ANDROID_BINDER_IPC=y
CONFIG_ANDROID_BINDERFS=y
CONFIG_ASHMEM=y
# CONFIG_ION is legacy; DMA-BUF heaps preferred on modern GKI
CONFIG_DMABUF_HEAPS=y
CONFIG_DMABUF_HEAPS_SYSTEM=y
CONFIG_PSI=y
CONFIG_SCHED_WALT=y
CONFIG_ENERGY_MODEL=y
CONFIG_CPU_FREQ_GOV_SCHEDUTIL=y

# --- Filesystems (Android) ---
CONFIG_EXT4_FS=y
CONFIG_F2FS_FS=y
CONFIG_F2FS_FS_SECURITY=y
CONFIG_F2FS_FS_COMPRESSION=y
CONFIG_EROFS_FS=y
CONFIG_SDCARD_FS=y
CONFIG_FUSE_FS=y
CONFIG_OVERLAY_FS=y
CONFIG_INCREMENTAL_FS=y

# --- Networking ---
CONFIG_NET=y
CONFIG_INET=y
CONFIG_IPV6=y
CONFIG_NETFILTER=y
CONFIG_NF_TABLES=y
CONFIG_PACKET=y
CONFIG_UNIX=y
CONFIG_CFG80211=m
CONFIG_MAC80211=m

# --- Block / storage ---
CONFIG_BLK_DEV_LOOP=y
CONFIG_BLK_DEV_DM=y
CONFIG_DM_CRYPT=y
CONFIG_DM_VERITY=y
CONFIG_SCSI=y
CONFIG_SCSI_UFSHCD=y
CONFIG_SCSI_UFSHCD_PLATFORM=y
CONFIG_SCSI_UFS_QCOM=y
CONFIG_MMC=y
CONFIG_MMC_SDHCI=y
CONFIG_MMC_SDHCI_MSM=y

# --- USB ---
CONFIG_USB=y
CONFIG_USB_SUPPORT=y
CONFIG_USB_GADGET=y
CONFIG_USB_CONFIGFS=y
CONFIG_TYPEC=y
CONFIG_PHY_QCOM_QMP=y
CONFIG_PHY_QCOM_QUSB2=y

# --- Input / HID ---
CONFIG_INPUT=y
CONFIG_INPUT_EVDEV=y
CONFIG_KEYBOARD_GPIO=y
CONFIG_INPUT_TOUCHSCREEN=y
CONFIG_TOUCHSCREEN_EDT_FT5X06=m
CONFIG_TOUCHSCREEN_NT36XXX=m
CONFIG_INPUT_MISC=y
CONFIG_INPUT_UINPUT=y

# --- Display / DRM ---
CONFIG_DRM=y
CONFIG_DRM_MSM=y
CONFIG_DRM_PANEL_SIMPLE=y
CONFIG_FB=y
CONFIG_FRAMEBUFFER_CONSOLE=y

# --- Sound ---
CONFIG_SOUND=y
CONFIG_SND=y
CONFIG_SND_SOC=y
CONFIG_SND_SOC_QCOM=y
CONFIG_SND_SOC_QDSP6=y

# --- Power / thermal ---
CONFIG_PM=y
CONFIG_PM_DEVFREQ=y
CONFIG_CPU_FREQ=y
CONFIG_CPU_IDLE=y
CONFIG_THERMAL=y
CONFIG_QCOM_TSENS=y
CONFIG_REGULATOR=y
CONFIG_REGULATOR_QCOM_SPMI=y
CONFIG_REGULATOR_QCOM_RPMH=y

# --- QCOM SoC helpers ---
CONFIG_QCOM_GDSC=y
CONFIG_QCOM_COMMAND_DB=y
CONFIG_QCOM_RPMH=y
CONFIG_QCOM_SMEM=y
CONFIG_QCOM_SMP2P=y
CONFIG_QCOM_SMSM=y
CONFIG_RPMSG_QCOM_GLINK_SMEM=y
CONFIG_QCOM_AOSS_QMP=y
CONFIG_PINCTRL_SDM660=y
CONFIG_CLK_X1E80100_GCC=n
CONFIG_SDM_GCC_660=y
CONFIG_SDM_GPUCC_660=y
CONFIG_INTERCONNECT_QCOM=y
CONFIG_INTERCONNECT_QCOM_SDM660=y

# --- Wireless ---
CONFIG_WLAN=y
CONFIG_ATH10K=m
CONFIG_ATH10K_SNOC=m
CONFIG_BT=m
CONFIG_BT_HCIUART=m
CONFIG_BT_QCOMSMD=m

# --- Security ---
CONFIG_SECURITY=y
CONFIG_SECURITY_SELINUX=y
CONFIG_SECURITY_APPARMOR=y
CONFIG_LSM="landlock,lockdown,yama,loadpin,safesetid,selinux,smack,tomoyo,apparmor,bpf"

# --- Debugging (disable for release builds) ---
# CONFIG_DEBUG_KERNEL is not set
CONFIG_PRINTK=y
CONFIG_DYNAMIC_DEBUG=y
CONFIG_MAGIC_SYSRQ=y

# --- Localversion ---
CONFIG_LOCALVERSION="-whyred-hybrid"
CONFIG_LOCALVERSION_AUTO=y
```

## drivers/whyred/Kconfig
```kconfig
# SPDX-License-Identifier: GPL-2.0-only
menuconfig WHYRED_DRIVERS
	bool "Xiaomi whyred (Redmi Note 5 Pro) device drivers"
	depends on ARCH_QCOM || COMPILE_TEST
	default y if ARCH_QCOM
	help
	  Board glue and helpers for Xiaomi whyred mainline kernel.
	  Most hardware is handled by upstream drivers via DT.

if WHYRED_DRIVERS

config WHYRED_BOARD
	tristate "Whyred board platform driver"
	default y
	help
	  Sysfs identity and panel geometry from DT (xiaomi,whyred-board).
	  Optional — provides board identification via sysfs.

endif # WHYRED_DRIVERS
```

## drivers/whyred/audio/Kconfig
```kconfig
config WHYRED_AUDIO
	tristate "Whyred audio machine driver glue"
	depends on SND_SOC
```

## drivers/whyred/camera/Kconfig
```kconfig
config WHYRED_CAMERA
	tristate "Whyred camera sensor glue"
	help
	  Camera on SDM660 Android usually needs CAMSS + vendor sensors.
	  Mainline CAMSS support may be incomplete — marked WIP.
```

## drivers/whyred/power/Kconfig
```kconfig
config WHYRED_POWER
	tristate "Whyred charger / fuel-gauge glue"
	depends on POWER_SUPPLY
```
